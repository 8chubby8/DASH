/* ===========================================================================
   DASH Module — Tank Gauge (WiFi)        |  module type: ACCESSORY
   Board: Espressif ESP32 DevKitC (WROOM-32, classic)  |  transport: WiFi TCP
          or Arduino Uno R4 WiFi — the same sketch builds for both (2026-10-01)
   Built on the DashModule library.       |  roadmap 1.6.5
   ---------------------------------------------------------------------------
   THE FIRST ACCESSORY. Every module before this one was invisible — a SYSTEM
   module publishes signals, a LISTENER consumes them, and neither puts anything
   on screen. This one owns a panel: it ships the artwork DASH draws, and then
   feeds it live values.

   WHAT IT SENDS, AND WHEN
     On INSTALL it streams three blocks out of flash — the layout document, and
     the two pieces of artwork the layout refers to:

       h_large_day   the panel description for the large horizontal slot
       dial.png      the gauge face
       gauge.svg     the needle, ticks, lamp and the three buttons

     Then it goes quiet until ACTIVATE, dumps everything it has, and from then
     on reports tank_pressure whenever it changes.

   THE TANK IS DRIVEN BY THE PANEL, NOT BY A TIMER (roadmap 1.6.7)
     Up to 1.6.6 this module ran a slow sweep across the whole range, which
     proved the needle moved but could never prove *why* it moved. Now nothing
     moves unless somebody presses something, so every movement on screen is
     attributable to the press that caused it — which is the entire point of the
     version, and worth losing the free demo for.

   WHAT THE THREE BUTTONS EXERCISE (module-layout.md §8)
     PLUS and MINUS are momentary — "one more than it is now" is not a value
     anybody can name in advance, so they carry none, DASH predicts nothing, and
     the needle moves when this module says it moved.

     ZERO names the variable and carries a literal, so DASH draws it immediately
     and waits to be told it was right. All three outcomes are reachable from
     this one panel: press ZERO and it is confirmed; press PLUS at 11 bar and
     the clamp below reports 11 unchanged, which is "heard, and could not
     comply" and is not an error; pull the power and press ZERO and the panel
     reverts when nothing answers.

   THE MODULE REPORTS FACTS. IT NEVER ISSUES INSTRUCTIONS (§8)
     Nothing below mentions a needle, a colour, a button or a panel. This module
     says what its pressure is; the layout decides what that looks like. That is
     why the same firmware would drive a completely redrawn panel without a line
     of it changing.

   THE LAYOUT IS THE DECLARATION (module-layout.md §9)
     An ACCESSORY declares no variables and no controls separately. The layout
     names every variable it binds and every control it can send, so DASH learns
     both by reading it. There is nothing else to declare — which is why this
     sketch's onInstall() is three blocks and nothing more.

   NO DashAccessory YET — AND THAT IS DELIBERATE
     The library ships DashSystem and DashListener; the ACCESSORY helper is held
     back to roadmap 1.6.10, so that it is written from something that has been
     proven on hardware rather than from the specification alone. That is the same
     order 1.4.15 used for the other two. The class below is therefore a hand-built
     stand-in, and it is the draft that helper gets extracted from — so it is
     written as if a stranger had to read it.

   ASSETS LIVE IN FLASH AND ARE STREAMED (module-sdk.md §8)
     gauge_assets.h is generated by make_assets.py from the files in assets/, with
     each CRC32 computed at build time. Nothing is ever held whole in RAM: blocks
     go out a chunk at a time straight from PROGMEM, which is what lets a board
     with kilobytes of memory ship a panel of any size.

   FIRST BUILD: copy arduino_secrets.h.example to arduino_secrets.h in this folder
   and fill it in — SECRET_SSID, SECRET_PASS, DASH_HOST (the DASH device's IP),
   DASH_PORT (3274). Your copy is gitignored; the .example is not.
   =========================================================================== */
#include <Dash.h>
#if defined(ARDUINO_UNOR4_WIFI)
#include <WiFiS3.h>            // Uno R4 WiFi radio (onboard ESP32-S3), as BodyWifi uses
#else
#include <WiFi.h>              // ESP32 core radio
#endif
#include "arduino_secrets.h"   // SECRET_SSID / SECRET_PASS / DASH_HOST / DASH_PORT
#include "gauge_assets.h"      // GENERATED — run make_assets.py after changing assets/

WiFiClient client;
#define DBG Serial

/* The ACCESSORY face is the library's DashAccessory since 1.6.10 — extracted
   from the draft class this sketch, and its two twins, carried until then. */

/* -------- the module ---------------------------------------------------------- */
// A distinct id from the SYSTEM modules on the bench so all of them can coexist.
// **The version is bumped whenever the layout changes, and that is not bookkeeping.** DASH
// captured this string at install and compares it against every HELLO (roadmap 1.4.13), so a
// module whose artwork or bindings have moved on while its version stands still would keep
// being drawn from the layout already on the tablet's disk. Bumping it is what makes DASH
// quarantine the stale record and offer the update that re-runs the handshake.
DashAccessory dash("0000DA58AC01", "Tank Gauge",
                        "Air-ride tank pressure panel over WiFi", "v1.5");

/* -------- this board's own pretend tank --------------------------------------- */
// No sensor wired up (the roadmap here is about the path, not the plumbing), so the
// value is held rather than measured. It moves only when the panel asks it to.
float pressure = 0.0;
const float PRESSURE_MIN = 0.0, PRESSURE_MAX = 11.0, PRESSURE_STEP = 1.0;

unsigned long lastLinkTry   = 0;
const unsigned long LINK_RETRY_MS = 3000;

// Everything this module knows, said out loud. One variable today; a real one
// would say all of them here, because the panel is drawn from what DASH has been
// told and nothing else.
void dumpState() {
  dash.report("tank_pressure", pressure, 1);
}

/* A press arrived. Move the tank, clamp it, and say where it ended up.

   THE CLAMP IS NOT A REFUSAL. Pressing PLUS at 11 bar reports 11 again — the
   module heard, and could not comply, and says so by stating the truth. There is
   no error message for it and there should not be: DASH draws facts (§8), and
   the fact is that the tank did not move.

   The report goes out unconditionally, including when nothing changed, because
   this is the acknowledgement as well as the value — §8 has no separate ROGER
   for actions, and a press that produced no change still needs answering or
   DASH is left waiting on a prediction nobody will ever confirm. */
void onPanelAction(const char* control, const char* value) {
  if      (strcmp(control, "pressure_up")   == 0) pressure += PRESSURE_STEP;
  else if (strcmp(control, "pressure_down") == 0) pressure -= PRESSURE_STEP;
  else if (strcmp(control, "tank_pressure") == 0) pressure = atof(value);
  else return;                       // not ours — stay quiet rather than answer

  if (pressure > PRESSURE_MAX) pressure = PRESSURE_MAX;
  if (pressure < PRESSURE_MIN) pressure = PRESSURE_MIN;

  DBG.print(F("[dash] ")); DBG.print(control);
  DBG.print(F(" -> ")); DBG.println(pressure);
  dash.report("tank_pressure", pressure, 1);
}

bool linkUp = false;

/* -------- WiFi: associate, connect, and go SILENT on any drop ------------------ */
// The inversion described in BodyWifi applies here too: on USB, DASH opens the
// device; on WiFi, DASH runs the server and this module is the client that dials
// in. So the firmware's extra job is keeping that socket up — and, the important
// part, calling linkLost() the moment it is not, because a dead socket sends no
// DEACTIVATE and the module would otherwise believe it was still active.
void maintainLink() {
  if (client.connected()) { linkUp = true; return; }

  if (linkUp) {
    DBG.println(F("[wifi] link lost — going SILENT"));
    dash.linkLost();
    linkUp = false;
  }

  unsigned long now = millis();
  if (now - lastLinkTry < LINK_RETRY_MS) return;
  lastLinkTry = now;

  if (WiFi.status() != WL_CONNECTED) {
    DBG.print(F("[wifi] associating to ")); DBG.println(SECRET_SSID);
    WiFi.begin(SECRET_SSID, SECRET_PASS);
    return;                       // try the socket on a later pass
  }

  DBG.print(F("[wifi] connecting to DASH at "));
  DBG.print(DASH_HOST); DBG.print(':'); DBG.println(DASH_PORT);
  if (client.connect(DASH_HOST, DASH_PORT)) {
    DBG.println(F("[wifi] connected"));
    linkUp = true;
  }
}

void setup() {
  DBG.begin(115200);
  delay(200);
  DBG.println();
  DBG.println(F("DASH Tank Gauge (ACCESSORY over WiFi)"));
  DBG.print(F("payload: ")); DBG.print(DASH_ASSET_COUNT);
  DBG.print(F(" blocks, ")); DBG.print(DASH_ASSET_TOTAL_BYTES); DBG.println(F(" bytes"));

#if !defined(ARDUINO_UNOR4_WIFI)
  WiFi.mode(WIFI_STA);           // ESP32 only — the R4's radio is a station already
#endif
  dash.onAction(onPanelAction);  // a button on the panel was pressed
  dash.setAssets(DASH_ASSETS, DASH_ASSET_COUNT);  // the install payload, from flash
  dash.onReport(dumpState);      // §8: on activation, and every heartbeat after
  dash.setHeartbeat(2000);
  dash.begin(client);            // a WiFiClient is a Stream; the library drives it
}

void loop() {
  maintainLink();
  dash.loop();   // the library runs the heartbeat while active
}
