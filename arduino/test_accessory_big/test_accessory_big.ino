/* ===========================================================================
   DASH Module — Big Test Accessory            |  module type: ACCESSORY
   ---------------------------------------------------------------------------
   A REFERENCE DASH module, written to be read — same discipline as the other
   reference sketches. Nothing here uses access a community builder couldn't
   have (the DASH "SDKable" principle).

   WHAT THIS MODULE IS
     A bench-test ACCESSORY whose one job is to make the install transfer
     *long enough to interrupt*, so DASH's designed install-failure work
     (roadmap 1.4.14) can be exercised on real hardware over plain USB:

         CANCEL        — hit CANCEL on the card mid-transfer
         DISCONNECTED  — pull the USB cable mid-transfer
         STALLED       — let the module wedge mid-install (see WEDGE below)

     It ships a big **icon pack** — ICON_COUNT synthetic icons of ICON_BYTES
     each — plus one big generated **panel layout** that references them all.
     At the defaults below that is ~100 KB over the wire, which at 115200 8N1
     takes roughly 9 seconds: a comfortable window to reach for the cable or
     the CANCEL button while the determinate progress bar climbs.

   WHY MANY MEDIUM BLOCKS, NOT ONE HUGE ONE  (the 1.4.14 subtlety)
     DASH's install idle-timeout is measured in *completed frames*, not raw
     bytes — the watchdog is reset each time a whole BLOCK arrives, because a
     block's payload is delivered to the install desk only once its last byte
     is in. So a single block that alone took longer than the timeout would
     trip STALLED even while its bytes were flowing. The fix is not to slow
     anything: it is simply to ship the pack as many smaller blocks. Each
     icon here is ICON_BYTES (~0.4 s on the wire) — far under the timeout — so
     a healthy transfer never false-STALLs, while the *total* is long enough
     to interrupt. Real accessories ship several assets anyway, so this is
     also just what a real install looks like.

   HOW THE ASSETS ARE MADE (and why they're tiny in flash)
     The icon bytes are *generated* from a deterministic hash of (icon index,
     byte offset) — genByte(). Nothing is stored: the CRC is computed by
     streaming the generator once, and the payload by streaming it again, both
     through a small chunk buffer. So a 100 KB transfer costs almost no flash
     and almost no RAM — exactly the §8 streaming discipline a real module
     uses to push a KB-scale asset out of flash without ever holding it whole.
     The generated bytes span the full 0..255 range (nulls, pipes, CRs and
     newlines included), so this doubles as a binary-safe-framing test.

   THE WIRE  (arduino/arduino.md §1, §2, §8)
     Plain UTF-8 text, one message per line, pipe-separated — with ONE
     exception: a BLOCK header

         BLOCK|id|name|length|crc

     is followed by exactly `length` RAW BYTES, framed by the byte count alone
     (they may contain newlines). Normal line framing resumes after them.

   THE CRC  (settled in DASH 1.4.4)
     CRC32 (standard zip polynomial), lowercase hex, no prefix, no padding —
     exactly String(crc, HEX). DASH parses it base-16.

   TARGET BOARD
     Arduino Uno R4 WiFi (or R3) over USB. Enumerates as a CDC serial port.

   BENCH ID MAP (keep assigned ids unique by hand, §3)
     Body USB …EE05 · Powertrain USB …EE06 · Body WiFi …EE07 ·
     Powertrain BT …EE08 · Big Test Accessory …EE0A (this one).
   ===========================================================================*/

#include <string.h>

/* ---------------------------------------------------------------------------
   TRANSPORT SELECTION — one ordinary Serial port (change to Serial1 for UART).
   --------------------------------------------------------------------------- */
#define DASH_SERIAL  Serial
#define DASH_BAUD    115200

/* ---------------------------------------------------------------------------
   TEST KNOBS — tune the transfer to taste.
     ICON_COUNT   number of icon blocks in the pack
     ICON_BYTES   bytes per icon (keep well under ~50 KB so no single block
                  approaches the DASH idle timeout — see the header note)
     WEDGE_AFTER_BLOCKS
                  0 = disabled (normal install). Set to e.g. 5 to make the
                  module deliberately FREEZE after sending that many blocks —
                  it stops mid-install without disconnecting, so DASH has
                  nothing to disconnect-detect and must fall back to its idle
                  timeout: watch the card go STALLED after ~10 s. This is the
                  clean way to test the STALLED path over USB (a cable-pull
                  gives DISCONNECTED instead, which is the fast path).

   Defaults: 24 icons × 4096 B + layout ≈ 100 KB ≈ ~9 s at 115200 8N1.
   --------------------------------------------------------------------------- */
#define ICON_COUNT          24
#define ICON_BYTES          4096
#define WEDGE_AFTER_BLOCKS  0

/* ---------------------------------------------------------------------------
   MODULE IDENTITY  (arduino/arduino.md §3, field caps §10)
   --------------------------------------------------------------------------- */
const char* MODULE_ID   = "0000DA58EE0A";              // assigned id — unique on the bench
const char* MODULE_TYPE = "ACCESSORY";                 // exactly one type (§4a)
const char* MODULE_NAME = "Big Test Accessory";        // <= 24 chars
const char* MODULE_DESC = "Large icon pack — 1.4.14 install-failure test"; // <= 64
const char* MODULE_VERS = "v1.0";                      // <= 12 chars

/* ---------------------------------------------------------------------------
   RUNTIME STATE — a module persists NOTHING about install state (§6). Boot
   SILENT; the only live state is whether DASH has ACTIVATEd us.
   --------------------------------------------------------------------------- */
bool active = false;

char    rxLine[64];
uint8_t rxLen = 0;

/* The generated panel layout, built once at boot into RAM (a few KB), then
   shipped as an ordinary literal block. Sized generously; the builder stops
   short of the cap so it can never overrun. */
#define LAYOUT_CAP 6144
char     layoutBuf[LAYOUT_CAP];
uint32_t layoutLen = 0;

/* A tiny periodic REPORT once active, so a completed install visibly comes to
   life (and stops dead on DEACTIVATE) — §6's live-only rule as a liveness tell. */
const unsigned long REPORT_EVERY_MS = 2000;
unsigned long lastReport  = 0;
long          reportCount = 0;


/* ================================  CRC32  ================================= */

// Standard CRC32 (reflected, poly 0xEDB88320) — matches java.util.zip.CRC32.
uint32_t crc32(const uint8_t* data, size_t len) {
  uint32_t crc = 0xFFFFFFFFul;
  for (size_t i = 0; i < len; i++) {
    crc ^= data[i];
    for (uint8_t b = 0; b < 8; b++) crc = (crc >> 1) ^ (0xEDB88320ul & (0ul - (crc & 1ul)));
  }
  return ~crc;
}


/* ===========================  GENERATED ASSETS  ========================== */

// Deterministic byte for icon `seed` at offset `off`. A cheap integer hash —
// full 0..255 spread, stable across the CRC pass and the send pass so the two
// can never disagree. This is the whole "asset" — no bytes are ever stored.
uint8_t genByte(uint16_t seed, uint32_t off) {
  uint32_t x = (uint32_t)seed * 2654435761ul + off * 2246822519ul + 3266489917ul;
  x ^= x >> 15; x *= 2246822519ul;
  x ^= x >> 13; x *= 3266489917ul;
  x ^= x >> 16;
  return (uint8_t)x;
}

// CRC of a generated icon, computed by streaming the generator (no buffer).
uint32_t crc32Generated(uint16_t seed, uint32_t len) {
  uint32_t crc = 0xFFFFFFFFul;
  for (uint32_t off = 0; off < len; off++) {
    crc ^= genByte(seed, off);
    for (uint8_t b = 0; b < 8; b++) crc = (crc >> 1) ^ (0xEDB88320ul & (0ul - (crc & 1ul)));
  }
  return ~crc;
}

// Append a null-terminated string to layoutBuf, never past the cap.
void layoutAppend(const char* s) {
  while (*s && layoutLen < LAYOUT_CAP - 1) layoutBuf[layoutLen++] = *s++;
}

// Build the panel layout once: a header plus, per icon, an icon overlay and a
// touch area. Arbitrary §11 provisional test content; DASH stores it and (until
// 1.6.x) renders nothing, so its exact text is immaterial — positions are
// integer percents to avoid any float-printf dependence. Stops short of the cap.
void buildLayout() {
  layoutLen = 0;
  layoutAppend("# DASH Big Test layout - provisional format (arduino.md section 11)\n");
  layoutAppend("# Generated to reference the whole icon pack. Test content only.\n");

  char line[80];
  for (int i = 0; i < ICON_COUNT; i++) {
    int col = i % 6, row = i / 6;
    int xPct = 6 + col * 15;    // 0.06, 0.21, ... as whole percents
    int yPct = 10 + row * 16;
    snprintf(line, sizeof(line), "OVERLAY|icon|icon_%02d|0.%02d|0.%02d|0.12|0.12\n", i, xPct, yPct);
    layoutAppend(line);
    snprintf(line, sizeof(line), "OVERLAY|touch|btn_%02d|0.%02d|0.%02d|0.12|0.12\n", i, xPct, yPct);
    layoutAppend(line);
  }
  layoutAppend("OVERLAY|text|title|0.50|0.94|@barText|20\n");
}


/* =====================  MESSAGES WE SEND TO DASH  ========================= */

// HELLO|id|type|name|description|version — our reply to DISCOVER (§4, §7).
void sendHello() {
  DASH_SERIAL.print(F("HELLO|"));
  DASH_SERIAL.print(MODULE_ID);   DASH_SERIAL.print('|');
  DASH_SERIAL.print(MODULE_TYPE); DASH_SERIAL.print('|');
  DASH_SERIAL.print(MODULE_NAME); DASH_SERIAL.print('|');
  DASH_SERIAL.print(MODULE_DESC); DASH_SERIAL.print('|');
  DASH_SERIAL.println(MODULE_VERS);
}

// Header helper: BLOCK|id|name|length|crc (crc lowercase hex, no prefix).
void sendBlockHeader(const char* name, uint32_t length, uint32_t crc) {
  char crcHex[9];
  snprintf(crcHex, sizeof(crcHex), "%lx", (unsigned long)crc);
  DASH_SERIAL.print(F("BLOCK|"));
  DASH_SERIAL.print(MODULE_ID);            DASH_SERIAL.print('|');
  DASH_SERIAL.print(name);                 DASH_SERIAL.print('|');
  DASH_SERIAL.print((unsigned long)length); DASH_SERIAL.print('|');
  DASH_SERIAL.println(crcHex);
}

// One generated icon block: header, then its bytes streamed from the generator
// through a small chunk buffer (§8) — never held whole in RAM. No trailing
// newline: the byte count is the entire framing.
void sendIconBlock(int idx) {
  char name[16];
  snprintf(name, sizeof(name), "icon_%02d", idx);
  uint32_t len = ICON_BYTES;
  sendBlockHeader(name, len, crc32Generated(idx, len));

  const uint32_t CHUNK = 32;
  uint8_t buf[CHUNK];
  for (uint32_t off = 0; off < len; off += CHUNK) {
    uint32_t n = len - off; if (n > CHUNK) n = CHUNK;
    for (uint32_t j = 0; j < n; j++) buf[j] = genByte(idx, off + j);
    DASH_SERIAL.write(buf, n);
  }
}

// One literal block (the layout): header, then the bytes verbatim.
void sendLiteralBlock(const char* name, const uint8_t* data, uint32_t len) {
  sendBlockHeader(name, len, crc32(data, len));
  const uint32_t CHUNK = 32;
  uint32_t sent = 0;
  while (sent < len) {
    uint32_t n = len - sent; if (n > CHUNK) n = CHUNK;
    DASH_SERIAL.write(data + sent, n);
    sent += n;
  }
}

// The ACCESSORY install handshake (§7, §8): a MANIFEST table of contents (block
// count + total payload bytes — this drives DASH's determinate progress bar),
// every BLOCK, then INSTALL_END.
void doInstall() {
  uint32_t total = (uint32_t)ICON_COUNT * ICON_BYTES + layoutLen;

  DASH_SERIAL.print(F("MANIFEST|"));
  DASH_SERIAL.print(MODULE_ID);          DASH_SERIAL.print('|');
  DASH_SERIAL.print(ICON_COUNT + 1);     DASH_SERIAL.print('|');
  DASH_SERIAL.println((unsigned long)total);

  int blocksSent = 0;
  for (int i = 0; i < ICON_COUNT; i++) {
    sendIconBlock(i);
    blocksSent++;
    // Simulate a wedged install: stop here, still connected, sending nothing
    // more. DASH has nothing to disconnect-detect, so its idle timeout must
    // catch it — the card goes STALLED after ~10 s. (No INSTALL_END is sent.)
    if (WEDGE_AFTER_BLOCKS > 0 && blocksSent >= WEDGE_AFTER_BLOCKS) return;
  }
  sendLiteralBlock("panel_layout", (const uint8_t*)layoutBuf, layoutLen);

  DASH_SERIAL.print(F("INSTALL_END|"));
  DASH_SERIAL.println(MODULE_ID);
}

// ROGER|id|which — acknowledges a command actually happened (§6).
void sendRoger(const char* which) {
  DASH_SERIAL.print(F("ROGER|"));
  DASH_SERIAL.print(MODULE_ID); DASH_SERIAL.print('|');
  DASH_SERIAL.println(which);
}

// REPORT|id|variable|value — the module's own agnostic panel data (§4).
void sendReport(const char* variable, long value) {
  DASH_SERIAL.print(F("REPORT|"));
  DASH_SERIAL.print(MODULE_ID); DASH_SERIAL.print('|');
  DASH_SERIAL.print(variable);  DASH_SERIAL.print('|');
  DASH_SERIAL.println(value);
}


/* =====================  MESSAGES WE RECEIVE FROM DASH  ==================== */

void handleLine() {
  if (rxLen == 0) return;

  char* field[6];
  int   n = 0;
  field[n++] = rxLine;
  for (char* p = rxLine; *p && n < 6; p++) {
    if (*p == '|') { *p = '\0'; field[n++] = p + 1; }
  }
  const char* type = field[0];

  // DISCOVER is the one message with no id — everyone answers (§4).
  if (strcmp(type, "DISCOVER") == 0) { sendHello(); return; }

  // Every other command names its target. Not for us? Stay quiet (§5).
  if (n < 2 || strcmp(field[1], MODULE_ID) != 0) return;

  if      (strcmp(type, "INSTALL")    == 0) { doInstall(); }
  else if (strcmp(type, "ACTIVATE")   == 0) { active = true;  sendRoger("activate"); }
  else if (strcmp(type, "DEACTIVATE") == 0) { active = false; sendRoger("deactivate"); }
  // Unknown TYPE: ignore — forward compatibility (§2).
}


/* ===========================  ARDUINO ENTRY POINTS  ====================== */

void setup() {
  buildLayout();
  DASH_SERIAL.begin(DASH_BAUD);
  // Boot SILENT: send NOTHING until spoken to (§6).
}

void loop() {
  while (DASH_SERIAL.available()) {
    char c = DASH_SERIAL.read();
    if (c == '\n') {
      rxLine[rxLen] = '\0';
      handleLine();
      rxLen = 0;
    } else if (c == '\r') {
      /* tolerate CRLF: drop the CR (§1) */
    } else if (rxLen < sizeof(rxLine) - 1) {
      rxLine[rxLen++] = c;
    } else {
      rxLen = 0;   // over-long line: drop it safely
    }
  }

  // Live data flows ONLY while active (§6).
  if (active && millis() - lastReport >= REPORT_EVERY_MS) {
    lastReport = millis();
    sendReport("test_counter", reportCount++);
  }
}
