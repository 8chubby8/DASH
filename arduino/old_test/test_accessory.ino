/* ===========================================================================
   DASH Module — Test Accessory               |  module type: ACCESSORY
   ---------------------------------------------------------------------------
   This is a REFERENCE DASH module, written to be read — same discipline as
   the steering wheel SYSTEM module. Nothing here uses access a community
   builder couldn't have (the DASH "SDKable" principle).

   WHAT THIS MODULE IS
     A bench-test ACCESSORY module. ACCESSORY modules own an agnostic
     interactive panel and ship visual assets to DASH at install time. This
     one exists for exactly one purpose: to prove DASH's ACCESSORY install
     path (roadmap 1.4.4) end to end on real hardware —

         MANIFEST -> BLOCK (raw bytes) -> BLOCK (raw bytes) -> INSTALL_END

     It ships THREE assets, chosen so the transfer test earns its keep:
       1. icon             — an SVG gauge face (multi-line text)
       2. panel_background — a REAL binary PNG (a little gauge tile)
       3. panel_layout     — arduino.md §11's *provisional* test layout
                             format, tying the background + overlays together
     The PNG is the important one: its bytes include nulls, pipes, CRs and
     newlines, so it proves DASH's length-prefixed framing is genuinely
     binary-safe — not merely tolerant of text with line breaks. The layout
     is arbitrary test content (the real panel spec, §11, is not locked) and
     DASH renders nothing at install anyway — it receives, CRC-checks, and
     stores. The finish line is DASH's Module Management screen: DISCOVER
     shows an ACCESSORY chip, INSTALL runs a determinate progress bar, the
     pane turns green, and DETAILS lists all three assets with the right
     byte counts.

     v2 (2026-07-07) — a second purpose, added once DASH 1.4.6 gave modules
     a live ACTIVE state: while ACTIVE, the module sends three REPORT
     variables every two seconds (see LIVE TEST REPORTS below). DASH routes
     REPORT nowhere until roadmap 1.4.9, but the lines show on the Serial
     Monitor wire tap — so the reports starting is visible proof an
     ACTIVATE landed, and their stopping dead is visible proof of a
     DEACTIVATE. The v1 sketch had a single such REPORT, off by default.

   WHAT IT DELIBERATELY DOES NOT DO
     - No ACTION / TRIGGER traffic — DASH routes none of that until roadmap
       1.4.9+. (REPORT is the one exception since v2, above — sent to be
       *watched*, not routed.)
     - No SUBSCRIBE lines — an ACCESSORY may subscribe (arduino.md §11), but
       keeping this sketch pure-accessory keeps the test unambiguous.
     - No variables / interactive-controls declarations — their install
       framing is an open item (arduino.md §10); per the 1.4.4 settlement an
       ACCESSORY install carries MANIFEST + BLOCKs only.

   THE WIRE  (arduino/arduino.md §1, §2, §8)
     Plain UTF-8 text, one message per line, pipe-separated positional
     fields — with ONE exception, and that exception is the whole point of
     this module: a BLOCK header line

         BLOCK|id|name|length|crc

     is followed by exactly `length` RAW BYTES. Those bytes are framed by
     the byte count alone — they may (and here deliberately DO) contain
     newlines, which DASH must read verbatim instead of line-splitting.
     After the last byte, normal line framing resumes immediately.

   THE CRC  (settled in DASH 1.4.4)
     CRC32 (the standard zip polynomial), sent as LOWERCASE HEXADECIMAL with
     no prefix and no padding — exactly what Arduino's String(crc, HEX)
     would produce. DASH parses the field base-16; a decimal CRC would fail
     every block and abort the install.

   TARGET BOARD
     Arduino Uno R4 WiFi (same bench board as the steering wheel module).
     Its USB Serial enumerates to the host as a CDC serial port, so this
     behaves exactly like a classic Uno R3.
   ===========================================================================*/

#include <string.h>   // strcmp — plain C string compare, no library needed

/* ---------------------------------------------------------------------------
   TRANSPORT SELECTION
   One ordinary Arduino Serial port. To run this exact code where the link to
   DASH is a UART instead, change ONE line to Serial1 — nothing else moves.
   --------------------------------------------------------------------------- */
#define DASH_SERIAL  Serial
#define DASH_BAUD    115200

/* ---------------------------------------------------------------------------
   MODULE IDENTITY  (arduino/arduino.md §3)
   Assigned id (the §3 no-MAC fallback), unique on this bench: the steering
   wheel module is ...EE01, so this one is ...EE02.
   --------------------------------------------------------------------------- */
const char* MODULE_ID = "0000DA58EE02";   // PLACEHOLDER assigned id — make it unique

/* ---------------------------------------------------------------------------
   IDENTITY TEXT  (sent in HELLO; field caps from arduino/arduino.md §10)
   --------------------------------------------------------------------------- */
const char* MODULE_TYPE = "ACCESSORY";               // exactly one type (§4a)
const char* MODULE_NAME = "Test Accessory";          // <= 24 chars
const char* MODULE_DESC = "Install path + live REPORT test module"; // <= 64
const char* MODULE_VERS = "v2.0";                    // <= 12 chars

/* ---------------------------------------------------------------------------
   THE TEST ASSETS
   Three blocks. The two text assets are multi-line ON PURPOSE, and the PNG
   is real binary — embedded newlines, nulls, pipe bytes and CRs are exactly
   what prove DASH's frame assembler reads a block payload verbatim by byte
   count, instead of line-splitting it. Content is otherwise arbitrary; DASH
   stores it, it does not render it yet.

   Real modules keep assets in flash and stream them out a chunk at a time,
   never holding a whole asset in RAM (§8). `const` arrays live in flash on
   this board; the chunked send in sendBlock() mirrors the streaming pattern.
   (On an AVR board you would add PROGMEM and pgm_read_byte — same idea.)
   --------------------------------------------------------------------------- */

// Asset 1: the module icon — a small SVG gauge face. The shape an ACCESSORY
// icon will actually take (§8 names the icon as an SVG).
const char ASSET_ICON[] =
  "<svg xmlns=\"http://www.w3.org/2000/svg\" viewBox=\"0 0 48 48\">\n"
  "  <defs>\n"
  "    <linearGradient id=\"bg\" x1=\"0\" y1=\"0\" x2=\"0\" y2=\"1\">\n"
  "      <stop offset=\"0\" stop-color=\"#3b82f6\"/>\n"
  "      <stop offset=\"1\" stop-color=\"#1e40af\"/>\n"
  "    </linearGradient>\n"
  "  </defs>\n"
  "  <rect x=\"3\" y=\"3\" width=\"42\" height=\"42\" rx=\"10\" fill=\"url(#bg)\"/>\n"
  "  <path d=\"M 12 32 A 14 14 0 1 1 36 32\" fill=\"none\" stroke=\"#ffffff\"\n"
  "        stroke-width=\"3.5\" stroke-linecap=\"round\" opacity=\"0.9\"/>\n"
  "  <line x1=\"24\" y1=\"27\" x2=\"32\" y2=\"16\" stroke=\"#ffd166\"\n"
  "        stroke-width=\"3\" stroke-linecap=\"round\"/>\n"
  "  <circle cx=\"24\" cy=\"27\" r=\"3.5\" fill=\"#ffffff\"/>\n"
  "</svg>\n";

// Asset 2: the panel background — a REAL 120x80 PNG (a dark gauge tile,
// generated offline, embedded as bytes). This is the §11 canvas model's
// visual foundation, and the binary-safety test: PNG bytes contain nulls,
// pipes, CRs and newlines, none of which may be treated as framing.
const uint8_t ASSET_PANEL_PNG[1352] = {
  0x89, 0x50, 0x4E, 0x47, 0x0D, 0x0A, 0x1A, 0x0A, 0x00, 0x00, 0x00, 0x0D,
  0x49, 0x48, 0x44, 0x52, 0x00, 0x00, 0x00, 0x78, 0x00, 0x00, 0x00, 0x50,
  0x08, 0x03, 0x00, 0x00, 0x00, 0xE5, 0x45, 0x41, 0xBB, 0x00, 0x00, 0x00,
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  0x49, 0x45, 0x4E, 0x44, 0xAE, 0x42, 0x60, 0x82
};

// Asset 3: the panel layout — arduino.md §11's PROVISIONAL test format
// (explicitly temporary, there to exercise the pipeline before the real
// spec is locked). It ties the other two assets together: the PNG as the
// canvas, a text overlay bound to the same `test_counter` variable the
// live test REPORTs send (v2), a transform stand-in for a needle, and
// a touch area. Note the pipes INSIDE this payload: block content is framed
// by byte count alone, so the §2 no-pipes rule (a rule about message
// *fields*) does not apply in here — a useful property to prove.
const char ASSET_LAYOUT[] =
  "# DASH test layout - provisional format (arduino.md section 11)\n"
  "# Arbitrary test content; the real panel spec is not locked.\n"
  "TEST_LAYOUT|panel_background\n"
  "TEST_OVERLAY|text|test_counter|0.50|0.20|@barText|18\n"
  "TEST_OVERLAY|transform|needle|test_counter|0.50|0.60\n"
  "TEST_OVERLAY|touch|test_button|0.80|0.78|0.16|0.14\n";

// The block table: name on the wire + the bytes. Lengths are compile-time
// (sizeof; minus 1 on the strings to drop the terminating NUL). CRCs are
// computed once in setup() — a real module would precompute them at build
// time (§8), but computing at boot keeps an edited asset and its checksum
// impossible to get out of sync.
struct Asset {
  const char*    name;      // BLOCK name field (no pipes, no newlines)
  const uint8_t* data;      // the raw bytes
  size_t         length;
  uint32_t       crc;       // filled in at setup()
};
Asset ASSETS[] = {
  { "icon",             (const uint8_t*)ASSET_ICON,   sizeof(ASSET_ICON) - 1,   0 },
  { "panel_background", ASSET_PANEL_PNG,              sizeof(ASSET_PANEL_PNG),  0 },
  { "panel_layout",     (const uint8_t*)ASSET_LAYOUT, sizeof(ASSET_LAYOUT) - 1, 0 },
};
const int ASSET_NUM = 3;

/* ---------------------------------------------------------------------------
   RUNTIME STATE
   A module persists NOTHING about install state — DASH is the single source
   of truth (§6). Boot SILENT; the only live-state is whether we are ACTIVE.
   --------------------------------------------------------------------------- */
bool active = false;          // SILENT until DASH sends ACTIVATE

/* Inbound line assembly. 64 bytes is ample (§10). */
char    rxLine[64];
uint8_t rxLen = 0;

/* ---------------------------------------------------------------------------
   LIVE TEST REPORTS  (v2)
   Three REPORT variables, sent every 2 s, ONLY while active — §6's rule
   that live data flows only while ACTIVE is exactly what makes these a
   liveness signal: they start when ACTIVATE lands and stop dead on
   DEACTIVATE. That start/stop IS the test.

   The variable names are not arbitrary. `test_counter` and `needle` are
   the two variables the panel_layout asset binds its overlays to, so when
   the module panel arrives (roadmap 1.6.x) this sketch is already a
   complete panel test module with live data feeding its own layout — and
   a ready-made bench module for REPORT routing (1.4.9) before that.
   `uptime_s` earns its place differently: if it ever resets to zero on
   the wire tap, you have just watched a brown-out reboot get caught and
   re-activated by DASH's reconciliation sweep.

   Three short lines per 2 s is nothing on a 115200 wire (well under 1%).
   --------------------------------------------------------------------------- */
const unsigned long REPORT_EVERY_MS = 2000;
unsigned long lastReport  = 0;
long          reportCount = 0;   // test_counter — proves messages keep coming
int           needleValue = 0;   // needle — bounces 0..100 so it visibly moves
int           needleStep  = 10;


/* ================================  CRC32  ================================= */

// Standard CRC32 (reflected, poly 0xEDB88320, init/final 0xFFFFFFFF) — the
// same algorithm as java.util.zip.CRC32 on the DASH side. Bitwise, no table:
// slower but tiny, and it only runs once per asset at boot.
uint32_t crc32(const uint8_t* data, size_t len) {
  uint32_t crc = 0xFFFFFFFFul;
  for (size_t i = 0; i < len; i++) {
    crc ^= data[i];
    for (uint8_t b = 0; b < 8; b++) {
      crc = (crc >> 1) ^ (0xEDB88320ul & (0ul - (crc & 1ul)));
    }
  }
  return ~crc;
}


/* =====================  MESSAGES WE SEND TO DASH  ========================= */

// HELLO|id|type|name|description|version   — our reply to DISCOVER (§4, §7)
void sendHello() {
  DASH_SERIAL.print(F("HELLO|"));
  DASH_SERIAL.print(MODULE_ID);   DASH_SERIAL.print('|');
  DASH_SERIAL.print(MODULE_TYPE); DASH_SERIAL.print('|');
  DASH_SERIAL.print(MODULE_NAME); DASH_SERIAL.print('|');
  DASH_SERIAL.print(MODULE_DESC); DASH_SERIAL.print('|');
  DASH_SERIAL.println(MODULE_VERS);
}

// BLOCK|id|name|length|crc  then exactly `length` raw bytes (§8).
// The CRC is lowercase hex, no prefix — the 1.4.4-settled format.
// (Takes an index into ASSETS rather than the struct itself: the Arduino
// preprocessor can place its auto-generated prototypes above the struct
// definition, so custom types in sketch function signatures are avoided.)
void sendBlock(int idx) {
  const Asset& a = ASSETS[idx];
  char crcHex[9];                                   // 8 hex digits + NUL
  snprintf(crcHex, sizeof(crcHex), "%lx", (unsigned long)a.crc);

  DASH_SERIAL.print(F("BLOCK|"));
  DASH_SERIAL.print(MODULE_ID);              DASH_SERIAL.print('|');
  DASH_SERIAL.print(a.name);                 DASH_SERIAL.print('|');
  DASH_SERIAL.print((unsigned long)a.length); DASH_SERIAL.print('|');
  DASH_SERIAL.println(crcHex);

  // The payload: raw bytes, written verbatim, in small chunks — the §8
  // streaming pattern (a real module streams a KB-scale asset out of flash
  // with a tiny working buffer; it never holds the whole asset in RAM).
  // NOTE: no println after the payload. The byte count is the entire
  // framing; the next thing on the wire is the next message line.
  const size_t CHUNK = 32;
  size_t sent = 0;
  while (sent < a.length) {
    size_t n = a.length - sent;
    if (n > CHUNK) n = CHUNK;
    DASH_SERIAL.write(a.data + sent, n);
    sent += n;
  }
}

// The install handshake for an ACCESSORY (§7, §8): a MANIFEST table of
// contents (block count + total payload bytes — this is what drives DASH's
// determinate progress bar), each BLOCK, then INSTALL_END.
void doInstall() {
  size_t totalBytes = 0;
  for (int i = 0; i < ASSET_NUM; i++) totalBytes += ASSETS[i].length;

  DASH_SERIAL.print(F("MANIFEST|"));
  DASH_SERIAL.print(MODULE_ID);   DASH_SERIAL.print('|');
  DASH_SERIAL.print(ASSET_NUM);   DASH_SERIAL.print('|');
  DASH_SERIAL.println((unsigned long)totalBytes);

  for (int i = 0; i < ASSET_NUM; i++) sendBlock(i);

  DASH_SERIAL.print(F("INSTALL_END|"));
  DASH_SERIAL.println(MODULE_ID);
}

// ROGER|id|which — acknowledges a command actually happened (§6).
void sendRoger(const char* which) {
  DASH_SERIAL.print(F("ROGER|"));
  DASH_SERIAL.print(MODULE_ID); DASH_SERIAL.print('|');
  DASH_SERIAL.println(which);
}

// REPORT|id|variable|value — the module's own agnostic panel data (§4).
void sendReport(const char* variable, long value) {
  DASH_SERIAL.print(F("REPORT|"));
  DASH_SERIAL.print(MODULE_ID); DASH_SERIAL.print('|');
  DASH_SERIAL.print(variable);  DASH_SERIAL.print('|');
  DASH_SERIAL.println(value);
}


/* =====================  MESSAGES WE RECEIVE FROM DASH  ==================== */

// Handle one complete line already sitting in rxLine (null-terminated).
void handleLine() {
  if (rxLen == 0) return;                       // ignore blank lines

  // Split on '|' in place — a plain split, exactly as §2 says.
  char* field[6];
  int   n = 0;
  field[n++] = rxLine;
  for (char* p = rxLine; *p && n < 6; p++) {
    if (*p == '|') { *p = '\0'; field[n++] = p + 1; }
  }
  const char* type = field[0];

  // DISCOVER is the one message with no id — everyone answers (§4).
  if (strcmp(type, "DISCOVER") == 0) { sendHello(); return; }

  // Every other command names its target. Not for us? Stay quiet (§5).
  if (n < 2 || strcmp(field[1], MODULE_ID) != 0) return;

  if      (strcmp(type, "INSTALL")    == 0) { doInstall(); }
  else if (strcmp(type, "ACTIVATE")   == 0) { active = true;  sendRoger("activate"); }
  else if (strcmp(type, "DEACTIVATE") == 0) { active = false; sendRoger("deactivate"); }
  // Unknown TYPE: ignore — forward compatibility (§2).
}


/* ===========================  ARDUINO ENTRY POINTS  ====================== */

void setup() {
  // Compute each asset's CRC once, so the BLOCK headers can never disagree
  // with the bytes that follow them.
  for (int i = 0; i < ASSET_NUM; i++) {
    ASSETS[i].crc = crc32(ASSETS[i].data, ASSETS[i].length);
  }

  DASH_SERIAL.begin(DASH_BAUD);
  // Boot SILENT: send NOTHING until spoken to (§6).
}

void loop() {
  // Read whatever DASH has sent, assembling complete lines.
  while (DASH_SERIAL.available()) {
    char c = DASH_SERIAL.read();
    if (c == '\n') {                 // end of message
      rxLine[rxLen] = '\0';
      handleLine();
      rxLen = 0;
    } else if (c == '\r') {          // tolerate CRLF: ignore the CR (§1)
      /* skip */
    } else if (rxLen < sizeof(rxLine) - 1) {
      rxLine[rxLen++] = c;
    } else {
      rxLen = 0;                     // over-long line: drop it safely
    }
  }

  // Live data flows ONLY while active (§6) — which is the whole point: the
  // reports starting is the proof of ACTIVATE, their stopping the proof of
  // DEACTIVATE.
  if (active && millis() - lastReport >= REPORT_EVERY_MS) {
    lastReport = millis();
    sendReport("test_counter", reportCount++);
    needleValue += needleStep;
    if (needleValue >= 100 || needleValue <= 0) needleStep = -needleStep;
    sendReport("needle", needleValue);
    sendReport("uptime_s", (long)(millis() / 1000));
  }
}
